## esp32_firmware/sdkconfig.defaults
```kconfig
# flash
CONFIG_ESPTOOLPY_FLASHSIZE_4MB=y
CONFIG_ESPTOOLPY_FLASHSIZE="4MB"

# ethernet
CONFIG_ETH_USE_SPI_ETHERNET=y
CONFIG_ETH_SPI_ETHERNET_W5500=y

# ws
CONFIG_HTTPD_WS_SUPPORT=y
CONFIG_HTTPD_SERVER_EVENT_POST_TIMEOUT=2000
CONFIG_WS_TRANSPORT=y
CONFIG_WS_BUFFER_SIZE=1024
CONFIG_HTTPD_WS_PRE_HANDSHAKE_CB_SUPPORT=y

# partitions
CONFIG_PARTITION_TABLE_CUSTOM=y
CONFIG_PARTITION_TABLE_CUSTOM_FILENAME="partitions.csv"
CONFIG_PARTITION_TABLE_FILENAME="partitions.csv"
CONFIG_PARTITION_TABLE_OFFSET=0x8000

# debug (only for dev)
CONFIG_COMPILER_OPTIMIZATION_DEBUG=y
CONFIG_COMPILER_OPTIMIZATION_ASSERTIONS_ENABLE=y

# mbedtls
CONFIG_MBEDTLS_SSL_SESSION_TICKETS=y
CONFIG_MBEDTLS_SERVER_SESSION_TICKETS=y
CONFIG_MBEDTLS_SSL_IN_CONTENT_LEN=4096
CONFIG_MBEDTLS_SSL_OUT_CONTENT_LEN=4096
CONFIG_MBEDTLS_ASYMMETRIC_CONTENT_LEN=y
```
